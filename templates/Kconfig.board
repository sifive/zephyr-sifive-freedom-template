## templates/Kconfig.board
```kconfig
config BOARD_<BOARD_IDENTIFIER>
	bool "<BOARD_NAME>"
	depends on SOC_RISCV32_SIFIVE_FREEDOM
	select HAS_DTS
```

## templates/Kconfig.defconfig
```kconfig
if BOARD_<BOARD_IDENTIFIER>

config BOARD
	default "<BOARD_NAME>"

config RISCV_ROM_BASE_ADDR
	default <ROM_BASE_ADDR> 

endif
```
